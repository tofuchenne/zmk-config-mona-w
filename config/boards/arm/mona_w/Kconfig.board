## config/boards/arm/mona_w/Kconfig.board
```kconfig
# Mona-W board configuration

# Copyright (c) 2020 The ZMK Contributors
# SPDX-License-Identifier: MIT

config BOARD_MONA_W
	bool "MONA_W"
	depends on SOC_NRF52840_QIAA
```

## config/west.yml
```yaml
manifest:
  remotes:
    - name: zmkfirmware
      url-base: https://github.com/zmkfirmware
    - name: rmi-kb
      url-base: https://github.com/rmi-kb
  projects:
    - name: zmk
      remote: zmkfirmware
      revision: main
      import: app/west.yml
  self:
    path: config
```
